## sdkconfig.defaults
```kconfig
# ESP32-P4 Camera Recorder Configuration (V4L2-style esp_video API)
CONFIG_IDF_TARGET="esp32p4"

# Chip revision (v1.0 = ECO1 for early FireBeetle 2 boards)
CONFIG_ESP32P4_REV_MIN_FULL=100

# Enable experimental features (required for 200MHz PSRAM on ESP32-P4)
CONFIG_IDF_EXPERIMENTAL_FEATURES=y

# ============================================================================
# PSRAM Configuration (32MB on FireBeetle 2)
# ============================================================================
CONFIG_SPIRAM=y
CONFIG_SPIRAM_MODE_HEX=y
CONFIG_SPIRAM_SPEED_200M=y
CONFIG_SPIRAM_BOOT_INIT=y
CONFIG_SPIRAM_USE_MALLOC=y
CONFIG_SPIRAM_MALLOC_ALWAYSINTERNAL=4096
CONFIG_SPIRAM_MALLOC_RESERVE_INTERNAL=32768

# ============================================================================
# ESP Video Framework Configuration
# ============================================================================
# Enable MIPI CSI video device (V4L2-style /dev/video0)
CONFIG_ESP_VIDEO_ENABLE_MIPI_CSI_VIDEO_DEVICE=y

# Enable ISP video device for RAW10 -> RGB/YUV processing
CONFIG_ESP_VIDEO_ENABLE_ISP_VIDEO_DEVICE=y

# Enable ISP Pipeline Controller for auto-exposure, auto-white-balance, etc.
CONFIG_ESP_VIDEO_ENABLE_ISP_PIPELINE_CONTROLLER=y
CONFIG_ISP_PIPELINE_CONTROLLER_TASK_STACK_USE_PSRAM=y

# Optional: Enable JPEG hardware encoder device (/dev/video10)
CONFIG_ESP_VIDEO_ENABLE_HW_JPEG_VIDEO_DEVICE=y

# Buffer management handled by esp_video framework

# ============================================================================
# Camera/ISP/JPEG Configuration
# ============================================================================
# MIPI CSI
CONFIG_CAM_CTLR_MIPI_CSI_ISR_IRAM_SAFE=y

# ISP (Image Signal Processor)  
CONFIG_ISP_CTRL_FUNC_IN_IRAM=y

# JPEG Encoder (hardware accelerated)
CONFIG_JPEG_ENABLE_DEBUG_LOG=n

# ============================================================================
# ESP Camera Sensor Configuration (esp-video-components)
# ============================================================================
# Enable IMX708 sensor driver
CONFIG_CAMERA_IMX708=y
CONFIG_CAMERA_IMX708_AUTO_DETECT_MIPI_INTERFACE_SENSOR=y

# IMX708 resolution/format (1280x720 @ 60fps RAW10)
CONFIG_CAMERA_IMX708_MIPI_RAW10_1280X720_60FPS=y

# IPA JSON configuration for IMX708

# MIPI link frequency (450MHz is the default for IMX708)
CONFIG_CAMERA_IMX708_MIPI_LINK_FREQ_450MHZ=y

# XCLK generation using ESP clock router (for IMX708 24MHz clock)
CONFIG_CAMERA_XCLK_USE_ESP_CLOCK_ROUTER=y

# ============================================================================
# SD Card (SDMMC)
# ============================================================================

# ============================================================================
# FAT Filesystem Optimization
# ============================================================================
# Write-back cache: reduces FAT table write-backs during sequential writes
CONFIG_FATFS_WRITE_BACK_CACHE=y
# Use internal DMA memory for FatFS buffers (PSRAM DMA is 16x slower)
# CONFIG_FATFS_ALLOC_PREFER_EXTMEM is intentionally NOT set

# ============================================================================
# Memory / Performance
# ============================================================================
# Larger main task stack for complex init
CONFIG_ESP_MAIN_TASK_STACK_SIZE=8192

# L2 Cache: 256KB with 128-byte lines (critical for PSRAM throughput)
CONFIG_CACHE_L2_CACHE_256KB=y
CONFIG_CACHE_L2_CACHE_LINE_128B=y

# Execute code from PSRAM via XIP (frees internal SRAM for DMA buffers)
CONFIG_SPIRAM_XIP_FROM_PSRAM=y

# Flash mode: QIO for 2x read bandwidth vs DIO
CONFIG_ESPTOOLPY_FLASHMODE_QIO=y

# Compiler optimization for performance
CONFIG_COMPILER_OPTIMIZATION_PERF=y

# H.264 hardware encoder (ESP32-P4 native, for future use)
CONFIG_ESP_VIDEO_ENABLE_HW_H264_VIDEO_DEVICE=y

# ============================================================================
# Autofocus (DW9807/DW9817 VCM motor on IMX708 Camera Module 3)
# ============================================================================
CONFIG_CAM_MOTOR_DW9807=y
CONFIG_CAM_MOTOR_DW9807_AUTO_DETECT=y
CONFIG_ESP_VIDEO_ENABLE_CAMERA_MOTOR_CONTROLLER=y
CONFIG_ESP_VIDEO_ISP_PIPELINE_CONTROL_CAMERA_MOTOR=y

# DMA memory

# ============================================================================
# Logging
# ============================================================================
CONFIG_LOG_DEFAULT_LEVEL_INFO=y
CONFIG_LOG_MAXIMUM_LEVEL_DEBUG=y

# ============================================================================
# FreeRTOS
# ============================================================================
CONFIG_FREERTOS_HZ=1000
CONFIG_FREERTOS_TIMER_TASK_STACK_DEPTH=3072
CONFIG_FREERTOS_ISR_STACKSIZE=2048
CONFIG_FREERTOS_WATCHPOINT_END_OF_STACK=y
CONFIG_FREERTOS_CHECK_STACKOVERFLOW_CANARY=y

# ============================================================================
# Compiler stack protection (detects stack smashing via canary)
# ============================================================================
CONFIG_COMPILER_STACK_CHECK_MODE_NORM=y

# Disable task watchdog (interferes with long SD card operations)
CONFIG_ESP_TASK_WDT_EN=n

# ============================================================================
# VFS (needed for V4L2-style device paths /dev/video*)
# ============================================================================
CONFIG_VFS_SUPPORT_IO=y
CONFIG_VFS_MAX_COUNT=16

# FATFS (SD card)
CONFIG_FATFS_LFN_HEAP=y
CONFIG_FATFS_VFS_FSTAT_BLKSIZE=4096

# ============================================================================
# Partition Table
# ============================================================================
# Use default single factory app partition
```
